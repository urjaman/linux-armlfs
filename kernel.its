## kernel.its
```
/dts-v1/;

/ {
    description = "Chrome OS kernel image with one or more FDT blobs";
    #address-cells = <1>;
    images {
        kernel {
            description = "kernel";
            data = /incbin/("arch/arm/boot/zImage");
            type = "kernel_noload";
            arch = "arm";
            os = "linux";
            compression = "none";
            load = <0>;
            entry = <0>;
        };
        fdt-veyron-brain {
            description = "rk3288-veyron-brain.dtb";
            data = /incbin/("arch/arm/boot/dts/rockchip/rk3288-veyron-brain.dtb");
            type = "flat_dt";
            arch = "arm";
            compression = "none";
            hash {
                algo = "sha1";
            };
        };
        fdt-veyron-jaq {
            description = "rk3288-veyron-jaq.dtb";
            data = /incbin/("arch/arm/boot/dts/rockchip/rk3288-veyron-jaq.dtb");
            type = "flat_dt";
            arch = "arm";
            compression = "none";
            hash {
                algo = "sha1";
            };
        };
        fdt-veyron-jerry {
            description = "rk3288-veyron-jerry.dtb";
            data = /incbin/("arch/arm/boot/dts/rockchip/rk3288-veyron-jerry.dtb");
            type = "flat_dt";
            arch = "arm";
            compression = "none";
            hash {
                algo = "sha1";
            };
        };
        fdt-veyron-mickey {
            description = "rk3288-veyron-mickey.dtb";
            data = /incbin/("arch/arm/boot/dts/rockchip/rk3288-veyron-mickey.dtb");
            type = "flat_dt";
            arch = "arm";
            compression = "none";
            hash {
                algo = "sha1";
            };
        };
        fdt-veyron-minnie {
            description = "rk3288-veyron-minnie.dtb";
            data = /incbin/("arch/arm/boot/dts/rockchip/rk3288-veyron-minnie.dtb");
            type = "flat_dt";
            arch = "arm";
            compression = "none";
            hash {
                algo = "sha1";
            };
        };
        fdt-veyron-pinky {
            description = "rk3288-veyron-pinky.dtb";
            data = /incbin/("arch/arm/boot/dts/rockchip/rk3288-veyron-pinky.dtb");
            type = "flat_dt";
            arch = "arm";
            compression = "none";
            hash {
                algo = "sha1";
            };
        };
        fdt-veyron-speedy {
            description = "rk3288-veyron-speedy.dtb";
            data = /incbin/("arch/arm/boot/dts/rockchip/rk3288-veyron-speedy.dtb");
            type = "flat_dt";
            arch = "arm";
            compression = "none";
            hash {
                algo = "sha1";
            };
        };
    };
    configurations {
        default = "conf-veyron-speedy";
        conf-veyron-brain {
            kernel = "kernel";
            fdt = "fdt-veyron-brain";
        };
        conf-veyron-jaq {
            kernel = "kernel";
            fdt = "fdt-veyron-jaq";
        };
        conf-veyron-jerry {
            kernel = "kernel";
            fdt = "fdt-veryon-jerry";
        };
        conf-veyron-mickey {
            kernel = "kernel";
            fdt = "fdt-veyron-mickey";
        };
        conf-veyron-minnie {
            kernel = "kernel";
            fdt = "fdt-veyron-minnie";
        };
        conf-veyron-pinky {
            kernel = "kernel";
            fdt = "fdt-veyron-pinky";
        };
        conf-veyron-speedy {
            kernel = "kernel";
            fdt = "fdt-veyron-speedy";
        };
    };


};
```
